## zephyr/Kconfig
```kconfig
# SPDX-License-Identifier: Apache-2.0
menuconfig RCL_LOGGING
        bool "RCL_LOGGING support"
        help
          This option enables RCL_LOGGING

if RCLC

endif
```
